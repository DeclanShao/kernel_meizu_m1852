/* Copyright (c) 2017, The Linux Foundation. All rights reserved.
 * Copyright (C) 2020 Meizu, Inc.
 *
 * This program is free software; you can redistribute it and/or modify
 * it under the terms of the GNU General Public License version 2 and
 * only version 2 as published by the Free Software Foundation.
 *
 * This program is distributed in the hope that it will be useful,
 * but WITHOUT ANY WARRANTY; without even the implied warranty of
 * MERCHANTABILITY or FITNESS FOR A PARTICULAR PURPOSE.  See the
 * GNU General Public License for more details.
 */
 
qcom,3449614_huaqin_ql1898_3210mah_averaged_masterslave_may29th2018 {
        qcom, = <24>;
        qcom,max-voltage-uv = <4400000>;
        qcom,nom-batt-capacity-mah = <3210>;
        qcom,batt-id-kohm = <47>;
        qcom,battery-beta = <3435>;
        qcom,fg-cc-cv-threshold-mv = <4390>;
        qcom,fastchg-current-ma = <2800>;
        qcom,jeita-fcc-ranges = <0 100 650000 
                                101 200 950000 
                                201 420 2800000 
                                421 600 1600000>;
        qcom,jeita-fv-ranges = <0 100 4400000 
                            101 200 4400000 
                            201 450 4400000 
                            451 600 4100000>;
        qcom,battery-type = "VEKEN";
        qcom,checksum = <0x4ff6>;
        qcom,gui-version = "PM660GUI - 0.0.0.45";
        qcom,fg-profile-data = [
                B6 1E 97 06 
                7C 03 07 F4 
                CC 1C 44 02 
                0A 0D 85 0B 
                AC 17 0E 2A 
                F1 4D D3 5A 
                64 00 00 00 
                0F 00 00 00 
                00 00 71 B5 
                A6 C4 BD BB 
                22 00 08 00 
                4F E2 76 e4 
                64 05 BA 01 
                9D 0C AD 0B 
                7C ED 6E 2B 
                27 06 09 20 
                27 00 14 00 
                C1 1F 88 05 
                8A 0A 3A 06 
                BB 1C 1E 03 
                D5 15 61 12 
                7F 18 F6 23 
                C1 4D 88 5B 
                68 00 00 00 
                0D 00 00 00 
                00 00 A1 D5 
                CB C2 A0 CA 
                18 00 00 00 
                63 EA 76 E4
                B3 FC C7 F3 
                35 FD 3C 02 
                2E DA 13 22 
                B6 33 CC FF 
                07 10 00 00 
                A4 0C 66 46 
                18 00 40 00 
                CC 01 0A FA 
                FF 00 00 00 
                00 00 00 00 
                00 00 00 00 
                00 00 00 00
                00 00 00 00
                00 00 00 00 
                00 00 00 00
                00 00 00 00 
                00 00 00 00 
                00 00 00 00 
                00 00 00 00 
                00 00 00 00 
                00 00 00 00 
                00 00 00 00 
                00 00 00 00 
                00 00 00 00 
                00 00 00 00 
                00 00 00 00 
                00 00 00 00
        ];
};