/* Copyright (c) 2017, The Linux Foundation. All rights reserved.
 * Copyright (C) 2020 Meizu, Inc.
 *
 * This program is free software; you can redistribute it and/or modify
 * it under the terms of the GNU General Public License version 2 and
 * only version 2 as published by the Free Software Foundation.
 *
 * This program is distributed in the hope that it will be useful,
 * but WITHOUT ANY WARRANTY; without even the implied warranty of
 * MERCHANTABILITY or FITNESS FOR A PARTICULAR PURPOSE.  See the
 * GNU General Public License for more details.
 */

qcom,3488744_huaqin_ql1898_atl_3210mah_averaged_masterslave_jul31st2018 {
        qcom, = <24>;
        qcom,max-voltage-uv = <4400000>;
        qcom,fg-cc-cv-threshold-mv = <4390>;
        qcom,nom-batt-capacity-mah = <3210>;
        qcom,batt-id-kohm = <100>;
        qcom,battery-beta = <3380>;
        qcom,fastchg-current-ma = <2800>;
        qcom,jeita-fcc-ranges = <0 100 650000 
                                101 200 950000 
                                201 420 2800000 
                                421 600 1600000>;
        qcom,jeita-fv-ranges = <0 100 4400000 
                            101 200 4400000 
                            201 450 4400000 
                            451 600 4100000>;
        qcom,battery-type = "ATL";
        qcom,checksum = <0x5c65>;
        qcom,gui-version = "PM660GUI - 0.0.0.45";
        qcom,fg-profile-data = [
                9B 1F 6F 05 
                80 0A 6D 06 
                73 1B E5 0A 
                D4 1D 4F 1A 
                61 17 B0 22 
                53 3C A3 4B 
                5F 00 00 00 
                15 00 00 00 
                00 00 92 BC 
                7F C4 02 00 
                1D 00 08 00 
                1A EA CA F5 
                C2 06 AC 00 
                ED EA 7C 0A 
                84 D4 99 22 
                49 06 09 20 
                27 00 14 00 
                8F 20 69 04 
                58 0B 8B 05 
                8A 1B 20 0B 
                A0 1D 7E 1A 
                20 18 70 22 
                94 3C 89 4B 
                62 00 00 00 
                14 00 00 00 
                00 00 61 CD 
                9D BA B9 C5 
                17 00 00 00 
                61 F3 CA F5 
                BF F4 3C EB 
                C5 F2 FF 0A 
                30 01 F2 1A 
                B1 33 CC FF 
                07 10 00 00 
                C3 0C 66 46 
                17 00 40 00 
                A4 01 0A FA 
                FF 00 00 00 
                00 00 00 00 
                00 00 00 00 
                00 00 00 00 
                00 00 00 00 
                00 00 00 00 
                00 00 00 00 
                00 00 00 00 
                00 00 00 00 
                00 00 00 00 
                00 00 00 00 
                00 00 00 00 
                00 00 00 00 
                00 00 00 00 
                00 00 00 00 
                00 00 00 00 
                00 00 00 00 
                00 00 00 00 
                00 00 00 00
        ];
};