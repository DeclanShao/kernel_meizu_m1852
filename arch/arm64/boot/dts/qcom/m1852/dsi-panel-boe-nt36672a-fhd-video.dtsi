/* Copyright (c) 2017, The Linux Foundation. All rights reserved.
 * Copyright (C) 2020 Meizu, Inc.
 *
 * This program is free software; you can redistribute it and/or modify
 * it under the terms of the GNU General Public License version 2 and
 * only version 2 as published by the Free Software Foundation.
 *
 * This program is distributed in the hope that it will be useful,
 * but WITHOUT ANY WARRANTY; without even the implied warranty of
 * MERCHANTABILITY or FITNESS FOR A PARTICULAR PURPOSE.  See the
 * GNU General Public License for more details.
 */

&mdss_mdp {
    dsi_boe_nt36672a_fhd_video: qcom,mdss_dsi_boe_nt36672a_fhd_video {
		qcom,mdss-dsi-panel-name = "BOE_NT36672A_FHD_VIDEO";
		qcom,mdss-dsi-panel-type = "dsi_video_mode";
		qcom,mdss-dsi-panel-controller = <&mdss_dsi0>;
		qcom,mdss-dsi-virtual-channel-id = <0>;
		qcom,mdss-dsi-stream = <0>;
		qcom,mdss-dsi-bpp = <24>;
		qcom,mdss-dsi-color-order = "rgb_swap_rgb";
		qcom,mdss-dsi-underflow-color = <0xff>;
		qcom,mdss-dsi-border-color = <0>;
		qcom,mdss-dsi-h-sync-pulse = <0>;
		qcom,mdss-dsi-traffic-mode = "non_burst_sync_event";
		qcom,mdss-dsi-lane-map = "lane_map_0123";
		qcom,mdss-dsi-bllp-eof-power-mode;
		qcom,mdss-dsi-bllp-power-mode;
		qcom,mdss-dsi-tx-eot-append;
		qcom,mdss-dsi-lane-0-state;
		qcom,mdss-dsi-lane-1-state;
		qcom,mdss-dsi-lane-2-state;
		qcom,mdss-dsi-lane-3-state;
		qcom,mdss-dsi-dma-trigger = "trigger_sw";
		qcom,mdss-dsi-mdp-trigger = "none";
		qcom,mdss-dsi-lp11-init;
		qcom,mdss-dsi-init-delay-us = <1000>;
		qcom,mdss-dsi-bl-pmic-control-type = "bl_ctrl_wled";
		qcom,mdss-dsi-bl-min-level = <1>;
		qcom,mdss-dsi-bl-max-level = <4095>;
		qcom,esd-check-enabled;
		qcom,mdss-dsi-panel-status-command = [06 01 00 01 05 00 02 0a 08];
		qcom,mdss-dsi-panel-status-command-state = "dsi_lp_mode";
		qcom,mdss-dsi-panel-status-check-mode = "reg_read";
		qcom,mdss-dsi-panel-status-value = <0x9c>;
		qcom,mdss-dsi-panel-status-read-length = <0x01>;
		qcom,mdss-dsi-panel-max-error-count = <0x0a>;
        qcom,mdss-dsi-reset-sequence = <1 10>, <0 10>, <1 15>;
		qcom,mdss-dsi-t-clk-post = <0x0f>;
		qcom,mdss-dsi-t-clk-pre = <0x39>;

		qcom,mdss-dsi-display-timings {

			timing@0 {
				qcom,mdss-dsi-panel-width = <1080>;
				qcom,mdss-dsi-panel-height = <2220>;
				qcom,mdss-dsi-h-front-porch = <224>;
				qcom,mdss-dsi-h-back-porch = <60>;
				qcom,mdss-dsi-h-pulse-width = <12>;
				qcom,mdss-dsi-h-sync-skew = <0>;
				qcom,mdss-dsi-v-back-porch = <24>;
				qcom,mdss-dsi-v-front-porch = <16>;
				qcom,mdss-dsi-v-pulse-width = <10>;
				qcom,mdss-dsi-panel-framerate = <60>;
				qcom,mdss-dsi-on-command = [
					39 01 00 00 00 00 02 ff 22 
					39 01 00 00 00 00 02 00 40 
					39 01 00 00 00 00 02 01 40 
					39 01 00 00 00 00 02 02 40 
					39 01 00 00 00 00 02 03 53 
					39 01 00 00 00 00 02 04 65 
					39 01 00 00 00 00 02 05 73 
					39 01 00 00 00 00 02 06 76 
					39 01 00 00 00 00 02 07 7f 
					39 01 00 00 00 00 02 08 7f 
					39 01 00 00 00 00 02 09 7f 
					39 01 00 00 00 00 02 0a 7b 
					39 01 00 00 00 00 02 0b 69 
					39 01 00 00 00 00 02 0c 5c 
					39 01 00 00 00 00 02 0d 48 
					39 01 00 00 00 00 02 0e 44 
					39 01 00 00 00 00 02 0f 41 
					39 01 00 00 00 00 02 10 40 
					39 01 00 00 00 00 02 11 50 
					39 01 00 00 00 00 02 12 60 
					39 01 00 00 00 00 02 13 70 
					39 01 00 00 00 00 02 14 58 
					39 01 00 00 00 00 02 15 68 
					39 01 00 00 00 00 02 16 78 
					39 01 00 00 00 00 02 17 77 
					39 01 00 00 00 00 02 18 40 
					39 01 00 00 00 00 02 19 40 
					39 01 00 00 00 00 02 1a 40 
					39 01 00 00 00 00 02 1b 40 
					39 01 00 00 00 00 02 1c 40 
					39 01 00 00 00 00 02 1d 40 
					39 01 00 00 00 00 02 1e 40 
					39 01 00 00 00 00 02 1f 40 
					39 01 00 00 00 00 02 20 40 
					39 01 00 00 00 00 02 21 45 
					39 01 00 00 00 00 02 22 49 
					39 01 00 00 00 00 02 23 4c 
					39 01 00 00 00 00 02 24 4b 
					39 01 00 00 00 00 02 25 48 
					39 01 00 00 00 00 02 26 44 
					39 01 00 00 00 00 02 27 41 
					39 01 00 00 00 00 02 28 40 
					39 01 00 00 00 00 02 2d 00 
					39 01 00 00 00 00 02 2f 40 
					39 01 00 00 00 00 02 30 54 
					39 01 00 00 00 00 02 31 5a 
					39 01 00 00 00 00 02 32 60 
					39 01 00 00 00 00 02 33 70 
					39 01 00 00 00 00 02 34 6a 
					39 01 00 00 00 00 02 35 6c 
					39 01 00 00 00 00 02 36 6c 
					39 01 00 00 00 00 02 37 68 
					39 01 00 00 00 00 02 38 62 
					39 01 00 00 00 00 02 39 5b 
					39 01 00 00 00 00 02 3a 53 
					39 01 00 00 00 00 02 3b 4d 
					39 01 00 00 00 00 02 3d 48 
					39 01 00 00 00 00 02 3f 44 
					39 01 00 00 00 00 02 40 41 
					39 01 00 00 00 00 02 41 40 
					39 01 00 00 00 00 02 42 40 
					39 01 00 00 00 00 02 43 40 
					39 01 00 00 00 00 02 44 40 
					39 01 00 00 00 00 02 45 40 
					39 01 00 00 00 00 02 46 40 
					39 01 00 00 00 00 02 47 40 
					39 01 00 00 00 00 02 48 40 
					39 01 00 00 00 00 02 49 40 
					39 01 00 00 00 00 02 4a 40 
					39 01 00 00 00 00 02 4b 40 
					39 01 00 00 00 00 02 4c 40 
					39 01 00 00 00 00 02 4d 40 
					39 01 00 00 00 00 02 4e 40 
					39 01 00 00 00 00 02 4f 40 
					39 01 00 00 00 00 02 50 40 
					39 01 00 00 00 00 02 51 40 
					39 01 00 00 00 00 02 52 40 
					39 01 00 00 00 00 02 53 01 
					39 01 00 00 00 00 02 54 00 
					39 01 00 00 00 00 02 55 88 
					39 01 00 00 00 00 02 56 76 
					39 01 00 00 00 00 02 58 4c 
					39 01 00 00 00 00 02 59 42 
					39 01 00 00 00 00 02 5a 40 
					39 01 00 00 00 00 02 5b 40 
					39 01 00 00 00 00 02 5c 40 
					39 01 00 00 00 00 02 5d 40 
					39 01 00 00 00 00 02 5e 40 
					39 01 00 00 00 00 02 5f 40 
					39 01 00 00 00 00 02 60 40 
					39 01 00 00 00 00 02 61 40 
					39 01 00 00 00 00 02 62 40 
					39 01 00 00 00 00 02 63 40 
					39 01 00 00 00 00 02 64 40 
					39 01 00 00 00 00 02 65 40 
					39 01 00 00 00 00 02 66 40 
					39 01 00 00 00 00 02 67 40 
					39 01 00 00 00 00 02 68 40 
					39 01 00 00 00 00 02 69 40 
					39 01 00 00 00 00 02 6a 40 
					39 01 00 00 00 00 02 6b 40 
					39 01 00 00 00 00 02 6c 40 
					39 01 00 00 00 00 02 6d 45 
					39 01 00 00 00 00 02 6e 49 
					39 01 00 00 00 00 02 6f 53 
					39 01 00 00 00 00 02 70 00 
					39 01 00 00 00 00 02 71 00 
					39 01 00 00 00 00 02 72 00 
					39 01 00 00 00 00 02 73 00 
					39 01 00 00 00 00 02 74 06 
					39 01 00 00 00 00 02 75 0c 
					39 01 00 00 00 00 02 76 03 
					39 01 00 00 00 00 02 77 09 
					39 01 00 00 00 00 02 78 0f 
					39 01 00 00 00 00 02 79 68 
					39 01 00 00 00 00 02 7a 88 
					39 01 00 00 00 00 02 7c 80 
					39 01 00 00 00 00 02 7d 80 
					39 01 00 00 00 00 02 7e 80 
					39 01 00 00 00 00 02 7f 00 
					39 01 00 00 00 00 02 80 00 
					39 01 00 00 00 00 02 81 00 
					39 01 00 00 00 00 02 83 01 
					39 01 00 00 00 00 02 84 00 
					39 01 00 00 00 00 02 85 80 
					39 01 00 00 00 00 02 86 80 
					39 01 00 00 00 00 02 87 80 
					39 01 00 00 00 00 02 88 40 
					39 01 00 00 00 00 02 89 a6 
					39 01 00 00 00 00 02 8a 94 
					39 01 00 00 00 00 02 8b 80 
					39 01 00 00 00 00 02 8c 80 
					39 01 00 00 00 00 02 8d 80 
					39 01 00 00 00 00 02 8e 80 
					39 01 00 00 00 00 02 8f 80 
					39 01 00 00 00 00 02 90 80 
					39 01 00 00 00 00 02 91 80 
					39 01 00 00 00 00 02 92 80 
					39 01 00 00 00 00 02 93 80 
					39 01 00 00 00 00 02 94 80 
					39 01 00 00 00 00 02 95 80 
					39 01 00 00 00 00 02 96 80 
					39 01 00 00 00 00 02 97 80 
					39 01 00 00 00 00 02 98 80 
					39 01 00 00 00 00 02 99 80 
					39 01 00 00 00 00 02 9a 80 
					39 01 00 00 00 00 02 9b 80 
					39 01 00 00 00 00 02 9c 80 
					39 01 00 00 00 00 02 9d 80 
					39 01 00 00 00 00 02 9e 80 
					39 01 00 00 00 00 02 9f 80 
					39 01 00 00 00 00 02 a0 8d 
					39 01 00 00 00 00 02 a2 80 
					39 01 00 00 00 00 02 a6 80 
					39 01 00 00 00 00 02 a7 80 
					39 01 00 00 00 00 02 a9 80 
					39 01 00 00 00 00 02 aa 80 
					39 01 00 00 00 00 02 ab 80 
					39 01 00 00 00 00 02 ac 80 
					39 01 00 00 00 00 02 ad 80 
					39 01 00 00 00 00 02 ae 80 
					39 01 00 00 00 00 02 af 80 
					39 01 00 00 00 00 02 b7 76 
					39 01 00 00 00 00 02 b8 76 
					39 01 00 00 00 00 02 b9 05 
					39 01 00 00 00 00 02 ba 0d 
					39 01 00 00 00 00 02 bb 14 
					39 01 00 00 00 00 02 bc 0f 
					39 01 00 00 00 00 02 bd 18 
					39 01 00 00 00 00 02 be 1f 
					39 01 00 00 00 00 02 bf 05 
					39 01 00 00 00 00 02 c0 0d 
					39 01 00 00 00 00 02 c1 14 
					39 01 00 00 00 00 02 c2 03 
					39 01 00 00 00 00 02 c3 07 
					39 01 00 00 00 00 02 c4 0a 
					39 01 00 00 00 00 02 c5 a0 
					39 01 00 00 00 00 02 c6 55 
					39 01 00 00 00 00 02 c7 ff 
					39 01 00 00 00 00 02 c8 39 
					39 01 00 00 00 00 02 c9 44 
					39 01 00 00 00 00 02 ca 12 
					39 01 00 00 00 00 02 cd 80 
					39 01 00 00 00 00 02 db 80 
					39 01 00 00 00 00 02 dc 80 
					39 01 00 00 00 00 02 dd 80 
					39 01 00 00 00 00 02 e0 80 
					39 01 00 00 00 00 02 e1 80 
					39 01 00 00 00 00 02 e2 80 
					39 01 00 00 00 00 02 e3 80 
					39 01 00 00 00 00 02 e4 82 
					39 01 00 00 00 00 02 e5 40 
					39 01 00 00 00 00 02 e6 40 
					39 01 00 00 00 00 02 e7 40 
					39 01 00 00 00 00 02 e8 40 
					39 01 00 00 00 00 02 e9 40 
					39 01 00 00 00 00 02 ea 40 
					39 01 00 00 00 00 02 eb 40 
					39 01 00 00 00 00 02 ec 40 
					39 01 00 00 00 00 02 ed 40 
					39 01 00 00 00 00 02 ee 40 
					39 01 00 00 00 00 02 ef 40 
					39 01 00 00 00 00 02 f0 40 
					39 01 00 00 00 00 02 f1 40 
					39 01 00 00 00 00 02 f2 40 
					39 01 00 00 00 00 02 f3 40 
					39 01 00 00 00 00 02 f4 40 
					39 01 00 00 00 00 02 f5 40 
					39 01 00 00 00 00 02 f6 40 
					39 01 00 00 00 00 02 fb 01 
					39 01 00 00 00 00 02 ff 26 
					39 01 00 00 00 00 02 fb 01 
					39 01 00 00 00 00 02 1c fa 
					39 01 00 00 00 00 02 ff 10 
					39 01 00 00 00 00 02 fb 01 
					39 01 00 00 00 00 02 55 80 
					05 01 00 00 78 00 02 11 00 
					05 01 00 00 14 00 02 29 00];
				qcom,mdss-dsi-gesture-off-command = [05 01 00 00 14 00 02 28 00];
				qcom,mdss-dsi-off-command = [05 01 00 00 14 00 02 28 00 05 01 00 00 78 00 02 10 00];
				qcom,mdss-dsi-on-command-state = "dsi_lp_mode";
				qcom,mdss-dsi-off-command-state = "dsi_hs_mode";
				qcom,mdss-dsi-gesture-off-command-state = "dsi_hs_mode";
				qcom,mdss-dsi-panel-phy-timings = [00 25 0a 0a 27 24 0a 0a 07 03 04 00];
				qcom,display-topology = <0x01 0x00 0x01>;
				qcom,default-topology-index = <0x00>;
			};
		};
	};
}