/* Copyright (c) 2017, The Linux Foundation. All rights reserved.
 * Copyright (C) 2020 Meizu, Inc.
 *
 * This program is free software; you can redistribute it and/or modify
 * it under the terms of the GNU General Public License version 2 and
 * only version 2 as published by the Free Software Foundation.
 *
 * This program is distributed in the hope that it will be useful,
 * but WITHOUT ANY WARRANTY; without even the implied warranty of
 * MERCHANTABILITY or FITNESS FOR A PARTICULAR PURPOSE.  See the
 * GNU General Public License for more details.
 */

&mdss_mdp {
    dsi_boe_nt36670a_fhd_video: qcom,mdss_dsi_boe_nt36670a_fhd_video {
        qcom,mdss-dsi-panel-name = "BOE_NT36670A_FHD_VIDEO";
        qcom,mdss-dsi-panel-type = "dsi_video_mode";
        qcom,mdss-dsi-panel-controller = <0xffffffff>;
        qcom,mdss-dsi-virtual-channel-id = <0x00>;
        qcom,mdss-dsi-stream = <0x00>;
        qcom,mdss-dsi-h-left-border = <0x00>;
        qcom,mdss-dsi-h-right-border = <0x00>;
        qcom,mdss-dsi-v-top-border = <0x00>;
        qcom,mdss-dsi-v-bottom-border = <0x00>;
        qcom,mdss-dsi-bpp = <0x18>;
        qcom,mdss-dsi-color-order = "rgb_swap_rgb";
        qcom,mdss-dsi-underflow-color = <0xff>;
        qcom,mdss-dsi-border-color = <0x00>;
        qcom,mdss-dsi-h-sync-pulse = <0x00>;
        qcom,mdss-dsi-traffic-mode = "non_burst_sync_event";
        qcom,mdss-dsi-lane-map = "lane_map_0123";
        qcom,mdss-dsi-bllp-eof-power-mode;
        qcom,mdss-dsi-bllp-power-mode;
        qcom,mdss-dsi-tx-eot-append;
        qcom,mdss-dsi-lane-0-state;
        qcom,mdss-dsi-lane-1-state;
        qcom,mdss-dsi-lane-2-state;
        qcom,mdss-dsi-lane-3-state;
        qcom,mdss-dsi-dma-trigger = "trigger_sw";
        qcom,mdss-dsi-mdp-trigger = "none";
        qcom,mdss-dsi-lp11-init;
        qcom,mdss-dsi-init-delay-us = <0x3e8>;
        qcom,mdss-dsi-bl-pmic-control-type = "bl_ctrl_wled";
        qcom,mdss-dsi-bl-min-level = <0x01>;
        qcom,mdss-dsi-bl-max-level = <0xfff>;
        qcom,esd-check-enabled;
        qcom,mdss-dsi-panel-status-command = [06 01 00 01 05 00 02 0a 08];
        qcom,mdss-dsi-panel-status-command-state = "dsi_lp_mode";
        qcom,mdss-dsi-panel-status-check-mode = "reg_read";
        qcom,mdss-dsi-panel-status-value = <0x9c>;
        qcom,mdss-dsi-panel-status-read-length = <0x01>;
        qcom,mdss-dsi-panel-max-error-count = <0x0a>;
        qcom,mdss-dsi-reset-sequence = <0x01 0x0a 0x00 0x0a 0x01 0x0f>;
        qcom,mdss-dsi-t-clk-post = <0x0e>;
        qcom,mdss-dsi-t-clk-pre = <0x33>;
        qcom,panel-supply-entries = <0x70>;
        qcom,mdss-dsi-mode-sel-gpio-state = "single_port";
        qcom,platform-reset-gpio = <0xffffffff 0x4b 0x00>;
        qcom,platform-te-gpio = <0xffffffff 0x0a 0x00>;
        linux,phandle = <0x85>;
        phandle = <0x85>;

        qcom,mdss-dsi-display-timings {

            timing@0 {
                qcom,mdss-dsi-panel-width = <0x438>;
                qcom,mdss-dsi-panel-height = <0x8ac>;
                qcom,mdss-dsi-h-front-porch = <0x32>;
                qcom,mdss-dsi-h-back-porch = <0x32>;
                qcom,mdss-dsi-h-pulse-width = <0x01>;
                qcom,mdss-dsi-h-sync-skew = <0x00>;
                qcom,mdss-dsi-v-back-porch = <0x22>;
                qcom,mdss-dsi-v-front-porch = <0x10>;
                qcom,mdss-dsi-v-pulse-width = <0x01>;
                qcom,mdss-dsi-panel-framerate = <0x3c>;
                qcom,mdss-dsi-on-command = [39 01 00 00 00 00 02 ff 22 39 01 00 00 00 00 02 fb 01 39 01 00 00 00 00 11 00 40 40 40 53 65 73 76 7f 7f 7f 7b 69 5c 48 44 41 39 01 00 00 00 00 02 01 40 39 01 00 00 00 00 02 08 50 39 01 00 00 00 00 02 09 60 39 01 00 00 00 00 02 0a 70 39 01 00 00 00 00 02 0b 58 39 01 00 00 00 00 02 0c 68 39 01 00 00 00 00 02 0d 78 39 01 00 00 00 00 02 19 77 39 01 00 00 00 00 11 02 40 40 40 40 40 40 40 40 40 45 49 4c 4b 48 44 41 39 01 00 00 00 00 02 03 40 39 01 00 00 00 00 02 1e 00 39 01 00 00 00 00 11 04 40 54 5a 60 70 6a 6c 6c 68 62 5b 53 4d 48 44 41 39 01 00 00 00 00 02 05 40 39 01 00 00 00 00 11 06 40 40 40 40 40 40 40 40 40 40 40 40 40 40 40 40 39 01 00 00 00 00 02 07 40 39 01 00 00 00 00 02 1a 01 39 01 00 00 00 00 02 1b 00 39 01 00 00 00 00 02 1c 88 39 01 00 00 00 00 02 1d 76 39 01 00 00 00 00 11 14 4c 42 40 40 40 40 40 40 40 40 40 40 40 40 40 40 39 01 00 00 00 00 09 15 40 40 40 40 40 45 49 53 39 01 00 00 00 00 0d 16 00 00 00 00 00 00 00 00 00 00 00 00 39 01 00 00 00 00 02 0e 00 39 01 00 00 00 00 02 0f 06 39 01 00 00 00 00 02 10 0c 39 01 00 00 00 00 02 11 03 39 01 00 00 00 00 02 12 09 39 01 00 00 00 00 02 13 0f 39 01 00 00 00 00 02 17 68 39 01 00 00 00 00 02 18 88 39 01 00 00 00 00 0d 7e 80 80 80 80 80 80 80 80 80 80 80 80 39 01 00 00 00 00 02 7f 01 39 01 00 00 00 00 02 80 00 39 01 00 00 00 00 02 22 00 39 01 00 00 00 00 02 81 40 39 01 00 00 00 00 11 7c a6 94 80 80 80 80 80 80 80 80 80 80 80 80 80 80 39 01 00 00 00 00 09 7d 80 80 80 80 80 80 80 8d 39 01 00 00 00 00 02 cb 76 39 01 00 00 00 00 02 cc 76 39 01 00 00 00 00 02 b9 05 39 01 00 00 00 00 02 ba 0d 39 01 00 00 00 00 02 bb 14 39 01 00 00 00 00 02 bc 0f 39 01 00 00 00 00 02 bd 18 39 01 00 00 00 00 02 be 1f 39 01 00 00 00 00 02 bf 05 39 01 00 00 00 00 02 c0 0d 39 01 00 00 00 00 02 c1 14 39 01 00 00 00 00 02 c2 03 39 01 00 00 00 00 02 c3 07 39 01 00 00 00 00 02 c4 0a 39 01 00 00 00 00 02 c5 a0 39 01 00 00 00 00 02 c6 55 39 01 00 00 00 00 02 c7 ff 39 01 00 00 00 00 02 c8 39 39 01 00 00 00 00 02 c9 44 39 01 00 00 00 00 02 cd 12 39 01 00 00 00 00 02 ca 80 39 01 00 00 00 00 07 1f 40 40 40 40 40 40 39 01 00 00 00 00 07 20 40 40 40 40 40 40 39 01 00 00 00 00 07 21 40 40 40 40 40 40 39 01 00 00 00 00 02 ff 10 39 01 00 00 00 00 02 fb 01 39 01 00 00 00 00 02 55 80 39 01 00 00 00 00 02 bb 13 05 01 00 00 78 00 02 11 00 05 01 00 00 14 00 02 29 00];
                qcom,mdss-dsi-off-command = [05 01 00 00 14 00 02 28 00 05 01 00 00 78 00 02 10 00];
                qcom,mdss-dsi-on-command-state = "dsi_lp_mode";
                qcom,mdss-dsi-off-command-state = "dsi_hs_mode";
                qcom,mdss-dsi-panel-phy-timings = <0x210808 0x25220908 0x6030400>;
                qcom,display-topology = <0x01 0x00 0x01>;
                qcom,default-topology-index = <0x00>;
            };
        };
    };
}