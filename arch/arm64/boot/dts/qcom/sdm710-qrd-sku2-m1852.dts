/* Copyright (c) 2017, The Linux Foundation. All rights reserved.
 * Copyright (C) 2020 Meizu, Inc.
 *
 * This program is free software; you can redistribute it and/or modify
 * it under the terms of the GNU General Public License version 2 and
 * only version 2 as published by the Free Software Foundation.
 *
 * This program is distributed in the hope that it will be useful,
 * but WITHOUT ANY WARRANTY; without even the implied warranty of
 * MERCHANTABILITY or FITNESS FOR A PARTICULAR PURPOSE.  See the
 * GNU General Public License for more details.
 */

/dts-v1/;
/plugin/;

#include <dt-bindings/clock/qcom,gcc-sdm845.h>
#include <dt-bindings/clock/qcom,camcc-sdm845.h>
#include <dt-bindings/clock/qcom,dispcc-sdm845.h>
#include <dt-bindings/clock/qcom,rpmh.h>
#include <dt-bindings/interrupt-controller/arm-gic.h>

#include "sdm670-qrd.dtsi"
#include "pm660l.dtsi"

/ {
        model = "Qualcomm Technologies, Inc. SDM710 PM660 + PM660L QRD SKU2";
        compatible = "qcom,sdm670-qrd", "qcom,sdm670", "qcom,qrd";
        qcom,msm-id = <360 0>;
        qcom,board-id = <1179659 0>;
        qcom,pmic-id = <0x1001b 0x101011a 0x00 0x00>,
                        <0x1001b 0x102001a 0x00 0x00>,
                        <0x1001b 0x201011a 0x00 0x00>;
}


#include "m1852/sdm710-m1852.dtsi"